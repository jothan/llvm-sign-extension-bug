## sdkconfig.defaults
```kconfig
# Rust often needs a bit of an extra main task stack size compared to C (the default is 3K)
CONFIG_ESP_MAIN_TASK_STACK_SIZE=8000
CONFIG_PTHREAD_TASK_STACK_SIZE_DEFAULT=8192
CONFIG_ESP_SYSTEM_EVENT_TASK_STACK_SIZE=8192
CONFIG_FREERTOS_IDLE_TASK_STACKSIZE=4096
CONFIG_ESP_TIMER_TASK_STACK_SIZE=8192
CONFIG_LWIP_MAX_SOCKETS=16

# Use this to set FreeRTOS kernel tick frequency to 1000 Hz (100 Hz by default).
# This allows to use 1 ms granuality for thread sleeps (10 ms by default).
CONFIG_FREERTOS_HZ=1000
CONFIG_LWIP_IPV6_AUTOCONFIG=y
CONFIG_LWIP_IPV6=y
CONFIG_LWIP_IPV6_NUM_ADDRESSES=3
CONFIG_LWIP_IPV6_RDNSS_MAX_DNS_SERVERS=2

CONFIG_MBEDTLS_CERTIFICATE_BUNDLE=y
CONFIG_MBEDTLS_CERTIFICATE_BUNDLE_DEFAULT_CMN=y
CONFIG_MBEDTLS_HAVE_TIME=y
CONFIG_MBEDTLS_HAVE_TIME_DATE=y
CONFIG_MBEDTLS_THREADING_C=y
CONFIG_MBEDTLS_THREADING_PTHREAD=y
CONFIG_MBEDTLS_THREADING_ALT=n
CONFIG_MBEDTLS_DEFAULT_MEM_ALLOC=y

CONFIG_ESP_DEFAULT_CPU_FREQ_MHZ_240=y
CONFIG_ESP_DEFAULT_CPU_FREQ_MHZ=240

#CONFIG_LOG_DEFAULT_LEVEL_WARN=y
#CONFIG_LOG_DEFAULT_LEVEL=2
CONFIG_COMPILER_OPTIMIZATION_ASSERTION_LEVEL=1
CONFIG_OPTIMIZATION_ASSERTIONS_SILENT=y
CONFIG_NEWLIB_NANO_FORMAT=y


CONFIG_ESP32_REV_MIN_3=y
CONFIG_ESP32_REV_MIN=3
CONFIG_ESP32_REV_MIN_FULL=300
CONFIG_ESP_REV_MIN_FULL=300
#CONFIG_FREERTOS_WATCHPOINT_END_OF_STACK=y

CONFIG_ESPTOOLPY_FLASHSIZE_4MB=y
CONFIG_ESPTOOLPY_FLASHFREQ="80m"
CONFIG_ESPTOOLPY_FLASHFREQ_80M=y
CONFIG_ESPTOOLPY_FLASHMODE="dio"
CONFIG_ESPTOOLPY_FLASHMODE_DIO=y

#
# SPI RAM config
#
CONFIG_SPIRAM=y
CONFIG_SPIRAM_MODE_QUAD=y
CONFIG_SPIRAM_TYPE_AUTO=y
#CONFIG_SPIRAM_SPEED_80M=y
#CONFIG_SPIRAM_SPEED=80
CONFIG_SPIRAM_BOOT_INIT=y
CONFIG_SPIRAM_IGNORE_NOTFOUND=y
CONFIG_SPIRAM_USE_MALLOC=y
CONFIG_SPIRAM_MEMTEST=y
CONFIG_SPIRAM_MALLOC_ALWAYSINTERNAL=512
CONFIG_SPIRAM_MALLOC_RESERVE_INTERNAL=65536
```
